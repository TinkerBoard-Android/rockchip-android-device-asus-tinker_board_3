/dts-v1/;
/plugin/;
/ {
	compatible = "rockchip,rk3566";

	fragment@0 {
		target = <&i2c4>;
		__overlay__ {
			status = "okay";
		};
	};

	fragment@1 {
		target = <&i2c4>;
		__overlay__ {
			ilitek@41 {
				compatible = "tchip,ilitek";
				reg = <0x41>;
				interrupt-parent = <&gpio4>;
				interrupts = <18 0x0>;
				ilitek,irq-gpio = <&gpio4 18 0x0>;
				ilitek,reset-gpio = <&gpio0 8 0x0>;
				ilitek,vbus = "vcc_i2c";
				ilitek,vdd = "vdd";
				ilitek,name = "ilitek_i2c";
				status = "okay";
			};
		};
	};
};
