/dts-v1/;
/plugin/;
/ {
        compatible = "rockchip,rk3566";

        fragment@0 {
                target = <&pwm7>;
                __overlay__ {
                        pinctrl-0 = <&pwm7_pins>;
                };
        };
  };
